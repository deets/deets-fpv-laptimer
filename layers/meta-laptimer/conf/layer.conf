## layers/meta-laptimer/conf/layer.conf
```bitbake
# We have a conf and classes directory, add to BBPATH
BBPATH .= ":${LAYERDIR}"

# # We have recipes-* directories, add to BBFILES
# BBFILES += "${LAYERDIR}/recipes-*/*/*.bb \
#             ${LAYERDIR}/recipes-*/*/*.bbappend"

# BBFILE_COLLECTIONS += "meta-laptimer"
# BBFILE_PATTERN_meta-laptimer = "^${LAYERDIR}/"
BBFILE_PRIORITY_meta-laptimer = "11"

LAYERDEPENDS_meta-laptimer = "core"
LAYERSERIES_COMPAT_meta-laptimer = "thud"

# this comes from the meta-rasberry and turns on
# ttyAMA0
ENABLE_UART = "1"
```
